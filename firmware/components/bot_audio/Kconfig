## firmware/components/bot_audio/Kconfig
```kconfig
menu "Xiaodai local audio"

config BOT_AUDIO_WAKE_MODEL_NAME
    string "Exact custom WakeNet model entry name"
    default ""
    help
        Provision an Espressif-compatible ESP32-S31 WakeNet model for the entire
        phrase 小呆小呆. Runtime requires both an exact entry-name match and exact
        full wake-word metadata. A valid dedicated model takes priority over
        the complete-phrase MultiNet7 fallback below. No stock keyword,
        split-name counter or VAD wake is substituted.

config BOT_AUDIO_MULTINET_WAKE_FALLBACK
    bool "Recognize complete xiao dai xiao dai locally with MultiNet7"
    depends on IDF_TARGET_ESP32S31
    default y
    help
        Uses ESP-SR's Chinese mn7_cn engine continuously when a matching
        dedicated WakeNet is unavailable. Passive mode installs exactly one
        whole phrase; an explicit session can additionally enable fixed local
        controls. No custom training or cloud service is needed.
        Also select SR_MN_CN_MULTINET7_QUANT and SR_MN_EN_NONE in ESP Speech
        Recognition so the pinned component packages the actual model. The
        build rejects a missing model selection instead of shipping a placeholder.
        CPU/RAM cost and acoustic accuracy need validation on this S31 board.

config BOT_AUDIO_MULTINET_THRESHOLD_PERCENT
    int "MultiNet full-command score threshold (percent, uncalibrated)"
    depends on BOT_AUDIO_MULTINET_WAKE_FALLBACK
    range 40 99
    default 80
    help
        Applied both to the model and to the highest-scoring result. This is a
        model score, not a measured confidence or a false-accept probability.
        Higher values can reduce false wakes but also miss genuine calls.

config BOT_AUDIO_MULTINET_WINDOW_MS
    int "MultiNet detection window (ms)"
    depends on BOT_AUDIO_MULTINET_WAKE_FALLBACK
    range 1000 6000
    default 3000
    help
        Native recognizer timeout. Detection, timeout, playback suppression,
        permission fences and the official VAD's speech-to-silence boundary
        clear partial state. Quiet speech has no additional absolute energy gate.

config BOT_AUDIO_LOCAL_COMMAND_THRESHOLD_PERCENT
    int "Active-session local command score threshold (percent)"
    depends on BOT_AUDIO_MULTINET_WAKE_FALLBACK
    range 70 99
    default 85
    help
        Fixed offline controls are available only after explicit activation.
        This is an uncalibrated model score; never a measured accuracy claim.

config BOT_AUDIO_START_BUFFER_MS
    int "Maximum explicitly authorized same-token start buffer (ms)"
    range 300 1500
    default 800
    help
        Bounded PSRAM only, after a runtime capture lease and RX/AFE fence.
        Keeps the latest samples while this token waits for transport readiness.
        Never stores passive/pre-wake audio; stop, playback, command consumption,
        revocation and token changes clear it. No cross-turn relabelling.

config BOT_AUDIO_AFE_RECOVERY_LIMIT
    int "Automatic AFE reset retries per start"
    range 0 3
    default 2
    help
        Reuses the existing AFE, with a delay, without restarting I2S or freeing
        live buffers. A persistent failure keeps explicit/manual operation.

config BOT_AUDIO_MODEL_PARTITION
    string "Model data partition label"
    default "model"
    help
        Must match a data partition in the project's partition table. Use the
        official ESP-SR MODEL_IN_FLASH path and external model packer.

config BOT_AUDIO_OUTPUT_VOLUME
    int "Default codec output volume (percent)"
    range 0 60
    default 30
    help
        Conservative electrical gain cap. This is not a measured acoustic
        exposure limit; speaker enclosure and listening distance need hardware
        validation before child use.

config BOT_AUDIO_MIC_GAIN_DB
    int "Microphone codec gain (dB)"
    range 0 42
    default 36

config BOT_AUDIO_WAKE_DEBOUNCE_MS
    int "Minimum gap between accepted full-phrase wake events (ms)"
    range 500 10000
    default 2000

config BOT_AUDIO_PLAYBACK_TAIL_MS
    int "Self-wake suppression tail after playback (ms)"
    range 200 3000
    default 800
    help
        Until reference synchronization is measured, wake events and VAD are
        suppressed from playback BEGIN, while the speaker plays and during
        this tail. PCM uplink is also withheld. Intentional
        touch/local stop can always cancel playback. Not a substitute for AEC.

config BOT_AUDIO_HARDWARE_REFERENCE_AEC
    bool "Use the S31 ES8389 synchronous MRMN playback reference for ESP-SR AEC"
    depends on IDF_TARGET_ESP32S31
    default n
    help
        Reads all four 16-bit 16-kHz TDM slots using the existing single codec
        owner. Slot 1 is the hardware DAC reference (official GMF S31 MRMN
        layout), slots 0/2 are microphones. The complete same-frame buffer is
        fed to ESP-SR AFE; no timestamped software FIFO pretends to be aligned.
        Allocation/format failures fall back to the existing half-duplex path.
        This is source integration, not a claim of measured acoustic quality.
        Do not enable in a release until the exact board and speaker have passed
        echo suppression, double-talk, silence, volume, drift and cancel tests.

config BOT_AUDIO_AEC_BARGE_IN
    bool "Allow locally detected AEC residual speech to interrupt a reply"
    depends on BOT_AUDIO_HARDWARE_REFERENCE_AEC
    default n
    help
        After a real playback operation and stable, unclipped hardware reference,
        sustained speech in AFE output emits a token-bound local interruption.
        Missing/stale/clipped reference closes this path immediately. PCM upload
        remains gated during playback; a new token and RX/AFE fence are required
        after interruption. No pre-wake or old-token onset is retransmitted.
        Default off until real-board double-talk/false-interruption validation.

config BOT_AUDIO_PLAYBACK_QUEUE_FRAMES
    int "Bounded playback queue capacity (20 ms frames)"
    range 4 32
    default 12

config BOT_AUDIO_WORKER_PRIORITY
    int "Audio worker priority"
    range 4 15
    default 8

endmenu
```

## firmware/components/bot_runtime/Kconfig
```kconfig
menu "Xiaodai local runtime"

    config BOT_RUNTIME_DAY_AWAKE_MS
        int "Daytime awake interval before a brief drowsy period (ms)"
        range 1000 86400000
        default 1200000
        help
            Begins after startup, an interaction, or the end of night. Daytime
            does not enter indefinite sleep merely because nobody interacts.

    config BOT_RUNTIME_DAY_DROWSY_MS
        int "Duration of a daytime drowsy period (ms)"
        range 1000 3600000
        default 60000
        help
            Automatically returns to awake afterwards without creating a
            conversation. Daytime local face detection may remain active.

    config BOT_RUNTIME_WAKING_MS
        int "Waking expression duration (milliseconds)"
        range 0 10000
        default 500

    config BOT_RUNTIME_PROGRESS_TIMEOUT_MS
        int "Maximum conversation progress gap (milliseconds)"
        range 10001 3600000
        default 60000
        help
            Hard upper bound between meaningful conversation transitions.
            Capture/network PCM and caption updates do not refresh this bound.
            Matching low-frequency hardware playback progress does, only after
            real codec writes. On expiry the local runtime stops output and
            closes the session. Input and output also have protocol size/time
            limits. This is not a silence detector. Must exceed WAKING_MS.
            The C API field is session_timeout_ms.

    config BOT_RUNTIME_WAKE_DEBOUNCE_MS
        int "Explicit wake debounce (milliseconds)"
        range 0 30000
        default 1500

endmenu
```

## firmware/main/Kconfig.projbuild
```kconfig
menu "ESP Bot"
    config ESPBOT_USB_DEBUG_PREVIEW
        bool "Enable supervised USB screen/camera preview"
        default n
        depends on ESPBOT_USB_MANUAL_CONTROL
        select LV_USE_SNAPSHOT
        help
            Explicit preview on/off and a 15-second keepalive lease enable
            two bounded JPEG previews and pixel-free runtime events over USB.
            Camera requires an explicit local wake or supervised USB camera
            command; night dark, settings and critical faults suppress it.

    config ESPBOT_USB_MANUAL_CONTROL
        bool "Enable local USB console wake/stop for board bring-up"
        default n
        help
            Accept exact wake and stop lines on the physical console UART.
            Wake posts the same intentional local event as a screen touch.
            No remote commands, media access or automatic wake is enabled.
            Disabled by default; intended for supervised board diagnosis.

    config ESPBOT_WIFI_SSID
        string "Wi-Fi SSID (blank reuses saved Wi-Fi, otherwise stays offline)"
        default ""

    config ESPBOT_WIFI_PASSWORD
        string "Wi-Fi password (stored locally in sdkconfig)"
        default ""

    config ESPBOT_DEVICE_ID
        string "Device ID (ASCII URL-safe)"
        default "korvo-01"

    config ESPBOT_SERVER_ID
        string "Preferred diagnostic bot-server ID (blank selects a sole server)"
        default ""
        help
            Discover the configured server again after each boot or connection
            loss, including when its DHCP address or listening port changes.
            Other servers are not selected automatically when this is set.
            This public ID selects a diagnostic endpoint; it is not authentication.

    config ESPBOT_NIGHT_SCHEDULE
        bool "Apply local night schedule when wall clock is valid"
        default y
        help
            After Wi-Fi connects, ESP-IDF SNTP synchronizes a local wall clock.
            When no valid clock is available the device does not guess night.
            SNTP is for the sleep schedule, not authentication or session time.

    config ESPBOT_NTP_SERVER
        string "SNTP server used by the night schedule"
        default "pool.ntp.org"
        depends on ESPBOT_NIGHT_SCHEDULE

    config ESPBOT_TIMEZONE
        string "POSIX timezone for night schedule"
        default "CST-8"
        depends on ESPBOT_NIGHT_SCHEDULE

    config ESPBOT_NIGHT_START_MINUTE
        int "Night begins, minutes after local midnight"
        range 0 1439
        default 1350
        depends on ESPBOT_NIGHT_SCHEDULE

    config ESPBOT_NIGHT_END_MINUTE
        int "Night ends, minutes after local midnight"
        range 0 1439
        default 420
        depends on ESPBOT_NIGHT_SCHEDULE

    config ESPBOT_GAZE_CALIBRATED
        bool "Camera-to-display orientation/geometry physically calibrated"
        default n
        help
            Keep disabled until real hardware calibration. Approximate visual
            following remains allowed, but mutual gaze is never claimed without
            calibration AND an independent human-gaze estimator.

    config ESPBOT_CAMERA_ROTATE_180
        bool "Rotate camera input 180 degrees"
        default n
        help
            The SC101IOT unit observed during board bring-up produced an
            upside-down preview with the old 180-degree rotation enabled.
            Leave disabled for that mounting. Other camera modules or mountings
            must be checked in the live preview; this is not an IMU measurement.

    config ESPBOT_GAZE_MIRROR_X
        bool "Mirror camera eye midpoint for display gaze"
        default n

    config ESPBOT_GAZE_MIRROR_Y
        bool "Mirror vertical eye midpoint for display gaze"
        default n

    config ESPBOT_CAMERA_FOV_X_DEG
        int "Approximate horizontal camera field of view, degrees"
        range 10 160
        default 60
        help
            Initial mapping parameter, not a measured OV3660 lens specification.
            Replace with calibrated effective FOV for the installed camera.

    config ESPBOT_CAMERA_FOV_Y_DEG
        int "Approximate vertical camera field of view, degrees"
        range 10 140
        default 45
endmenu
```
