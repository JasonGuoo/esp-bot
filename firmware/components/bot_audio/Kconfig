## firmware/components/bot_audio/Kconfig
```kconfig
menu "Xiaodai local audio"

config BOT_AUDIO_WAKE_MODEL_NAME
    string "Exact custom WakeNet model entry name"
    default ""
    help
        Provision an Espressif-compatible ESP32-S31 WakeNet model for the entire
        phrase 小呆小呆. Runtime requires both an exact entry-name match and exact
        full wake-word metadata. Empty/missing/wrong models report
        WAKE_MODEL_MISSING; no stock keyword or VAD fallback is substituted.

config BOT_AUDIO_MODEL_PARTITION
    string "Model data partition label"
    default "model"
    help
        Must match a data partition in the project's partition table. Use the
        official ESP-SR MODEL_IN_FLASH path and external model packer.

config BOT_AUDIO_OUTPUT_VOLUME
    int "Default codec output volume (percent)"
    range 0 60
    default 30
    help
        Conservative electrical gain cap. This is not a measured acoustic
        exposure limit; speaker enclosure and listening distance need hardware
        validation before child use.

config BOT_AUDIO_MIC_GAIN_DB
    int "Primary microphone codec gain (dB)"
    range 0 42
    default 24

config BOT_AUDIO_WAKE_DEBOUNCE_MS
    int "Minimum gap between accepted full-phrase wake events (ms)"
    range 500 10000
    default 2000

config BOT_AUDIO_PLAYBACK_TAIL_MS
    int "Self-wake suppression tail after playback (ms)"
    range 200 3000
    default 800
    help
        Until reference synchronization is measured, wake events and VAD are
        suppressed while the speaker plays and during this tail. Intentional
        touch/local stop can always cancel playback. Not a substitute for AEC.

config BOT_AUDIO_PLAYBACK_QUEUE_FRAMES
    int "Bounded playback queue capacity (20 ms frames)"
    range 4 32
    default 12

config BOT_AUDIO_WORKER_PRIORITY
    int "Audio worker priority"
    range 4 15
    default 8

endmenu
```

## firmware/components/bot_runtime/Kconfig
```kconfig
menu "Xiaodai local runtime"

    config BOT_RUNTIME_BORED_AFTER_MS
        int "Idle milliseconds before bored"
        range 1000 86400000
        default 60000
        help
            Counted from explicit interaction/session end, not camera activity.
            Must be smaller than DROWSY_AFTER_MS. Invalid combinations are
            rejected by bot_runtime_create; the runtime does not reorder them.

    config BOT_RUNTIME_DROWSY_AFTER_MS
        int "Idle milliseconds before drowsy"
        range 1001 86400001
        default 180000
        help
            Must be greater than BORED_AFTER_MS and less than SLEEP_AFTER_MS.

    config BOT_RUNTIME_SLEEP_AFTER_MS
        int "Idle milliseconds before sleeping"
        range 1002 86400002
        default 300000
        help
            Must be greater than DROWSY_AFTER_MS. Local wake-word capture stays
            running; this is not ESP deep sleep.

    config BOT_RUNTIME_WAKING_MS
        int "Waking expression duration (milliseconds)"
        range 0 10000
        default 500

    config BOT_RUNTIME_PROGRESS_TIMEOUT_MS
        int "Maximum conversation progress gap (milliseconds)"
        range 10001 3600000
        default 60000
        help
            Hard upper bound between meaningful conversation transitions.
            Includes continuous speech and continuous playback: neither raw
            PCM nor caption updates refreshes this bound. On expiry the local
            runtime stops output and closes the session. Set deliberately for
            long narration; this is not a silence detector. Must exceed
            WAKING_MS. The C API field is session_timeout_ms.

    config BOT_RUNTIME_WAKE_DEBOUNCE_MS
        int "Explicit wake debounce (milliseconds)"
        range 0 30000
        default 1500

    config BOT_RUNTIME_SLEEP_DISPLAY
        bool "Request display sleep during sleeping"
        default y
        help
            The platform still reports whether its panel/backlight path can
            actually sleep. Night-dark always requests display sleep. Touch
            and local wake-word capture must remain available.

endmenu
```

## firmware/components/bot_vision/Kconfig
```kconfig
menu "Bot vision"

    config BOT_VISION_TASK_STACK_BYTES
        int "Vision worker stack size in bytes"
        range 6144 32768
        default 8192
        help
            Stack for the single camera/model/tracker owner task. This is an
            unmeasured initial allocation; the official model and camera also
            allocate heap/PSRAM. Measure the high-water mark on real hardware.

    config BOT_VISION_TASK_PRIORITY
        int "Vision worker task priority"
        range 1 8
        default 3
        help
            Keep camera inference below the audio capture and runtime control
            tasks. No CPU affinity is forced; the official ESP-DL backend owns
            its inference scheduling.

endmenu
```

## firmware/main/Kconfig.projbuild
```kconfig
menu "ESP Bot"
    config ESPBOT_WIFI_SSID
        string "Wi-Fi SSID (blank keeps the complete local runtime offline)"
        default ""

    config ESPBOT_WIFI_PASSWORD
        string "Wi-Fi password (stored locally in sdkconfig)"
        default ""

    config ESPBOT_DEVICE_ID
        string "Device ID (ASCII URL-safe)"
        default "korvo-01"

    config ESPBOT_NIGHT_SCHEDULE
        bool "Apply local night schedule when wall clock is valid"
        default n
        help
            No network time source is started by this runtime. A future trusted
            time service or manual setup must initialize the wall clock first.
            Without a valid clock, ordinary passive timers continue to work.

    config ESPBOT_TIMEZONE
        string "POSIX timezone for night schedule"
        default "CST-8"
        depends on ESPBOT_NIGHT_SCHEDULE

    config ESPBOT_NIGHT_START_MINUTE
        int "Night begins, minutes after local midnight"
        range 0 1439
        default 1350
        depends on ESPBOT_NIGHT_SCHEDULE

    config ESPBOT_NIGHT_END_MINUTE
        int "Night ends, minutes after local midnight"
        range 0 1439
        default 420
        depends on ESPBOT_NIGHT_SCHEDULE

    config ESPBOT_GAZE_CALIBRATED
        bool "Camera-to-display orientation/geometry physically calibrated"
        default n
        help
            Keep disabled until real hardware calibration. Approximate visual
            following remains allowed, but mutual gaze is never claimed without
            calibration AND an independent human-gaze estimator.

    config ESPBOT_GAZE_MIRROR_X
        bool "Mirror camera eye midpoint for display gaze"
        default n

    config ESPBOT_GAZE_MIRROR_Y
        bool "Mirror vertical eye midpoint for display gaze"
        default n

    config ESPBOT_CAMERA_FOV_X_DEG
        int "Approximate horizontal camera field of view, degrees"
        range 10 160
        default 60
        help
            Initial mapping parameter, not a measured OV3660 lens specification.
            Replace with calibrated effective FOV for the installed camera.

    config ESPBOT_CAMERA_FOV_Y_DEG
        int "Approximate vertical camera field of view, degrees"
        range 10 140
        default 45
endmenu
```
